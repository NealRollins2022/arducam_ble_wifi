## Kconfig
```kconfig
config VIDEO_ARDUCAM_NORD
   bool "Arducam Mega CMOS digital image sensor"
	select SPI
	depends on DT_HAS_ARDUCAM_NORD_ENABLED
	default y
	help
	  Enable driver for Arducam Mega CMOS digital image sensor device.
```

## drivers/video/arducam_nord/Kconfig
```kconfig
config VIDEO_ARDUCAM_MEGA
    bool                  # ← Critical: NO prompt string → hidden symbol
    default y if DT_HAS_ARDUCAM_MEGA_ENABLED
    select VIDEO
    select SPI
    depends on DT_HAS_ARDUCAM_MEGA_ENABLED
    help
      Arducam Mega SPI camera driver (off-tree module).
      Automatically enables VIDEO and SPI subsystems.
```

## dts/bindings/video/arducam,nord.yaml
```yaml
# SPDX-License-Identifier: Apache-2.0
description: Arducam Nord SPI camera

compatible: "arducam,nord"

include: spi-device.yaml

properties:
  spi-max-frequency:
    type: int
    required: true   # or false if you want it optional
```
